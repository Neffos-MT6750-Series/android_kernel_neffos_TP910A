/ {
	rsee {
		compatible = "rongcard,rsee-tz";
		method = "smc";
	};
	spi0-clk {
		compatible = "rsee,peri-clk";
		clkname = "main";
		clocks = <&infrasys INFRA_SPI0>;
		clock-names = "main";
		clock-frequency = <109000000>;
		clock-div = <1>;
	};
};

